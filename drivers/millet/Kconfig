## drivers/millet/Kconfig
```kconfig
config MILLET
	bool "Millet event reporting framework"
	depends on NETFILTER
	default n
	help
	  Framework that forwards kernel events to user space over netlink.
```

## drivers/staging/rtmm/Kconfig
```kconfig
config RTMM
	bool "enable runtime mem optimization"
	select SYSFS
	default n
	help
	  Thie module is created by MIUI to optimize mem performance.

config MI_RECLAIM
	bool "enable mi reclaim"
	select SYSFS
	default n
	help
	  Anonymous page reclaim daemon.  Exposes /sys/kernel/mi_reclaim
	  and drives mi_reclaim_global() in mm/vmscan.c.
```
